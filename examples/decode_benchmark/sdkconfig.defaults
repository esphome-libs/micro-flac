## examples/decode_benchmark/sdkconfig.defaults
```kconfig
# FLAC Decode Benchmark - ESP-IDF Configuration

# Custom partition table (4MB app partition for large embedded audio)
CONFIG_PARTITION_TABLE_CUSTOM=y
CONFIG_PARTITION_TABLE_CUSTOM_FILENAME="partitions_4mb.csv"

# Disable watchdogs for uninterrupted benchmark
CONFIG_ESP_TASK_WDT_EN=n
CONFIG_ESP_TASK_WDT_INIT=n

# Main task stack size
CONFIG_ESP_MAIN_TASK_STACK_SIZE=10000

# Reduce log overhead during benchmark
CONFIG_LOG_DEFAULT_LEVEL_WARN=y

# Enable PSRAM
CONFIG_SPIRAM=y
CONFIG_SPIRAM_USE_CAPS_ALLOC=y

# Compiler optimizations
CONFIG_COMPILER_OPTIMIZATION_PERF=y
```

## examples/decode_benchmark/sdkconfig.defaults.esp32
```kconfig
# ESP32 specific settings
CONFIG_ESPTOOLPY_FLASHSIZE_4MB=y

# CPU Frequency
CONFIG_ESP_DEFAULT_CPU_FREQ_MHZ_240=y

# Octal PSRAM mode
CONFIG_SPIRAM_MODE_QUAD=y
CONFIG_SPIRAM_SPEED_80M=y
```

## examples/decode_benchmark/sdkconfig.defaults.esp32p4
```kconfig
# ESP32-P4 specific settings
CONFIG_ESPTOOLPY_FLASHSIZE_16MB=y

# CPU Frequency (360 MHz for pre-rev.300 eval board)
CONFIG_ESP_DEFAULT_CPU_FREQ_MHZ_360=y

# Hex (16-line) PSRAM mode - only mode available on P4
CONFIG_SPIRAM_MODE_HEX=y
CONFIG_SPIRAM_SPEED_200M=y
```

## examples/test_lpc_asm/sdkconfig.defaults
```kconfig
# LPC Assembly Test - ESP-IDF Configuration

# Custom partition table
CONFIG_PARTITION_TABLE_CUSTOM=y
CONFIG_PARTITION_TABLE_CUSTOM_FILENAME="partitions_4mb.csv"

# CPU Frequency
CONFIG_ESP_DEFAULT_CPU_FREQ_MHZ_240=y

# Disable watchdogs
CONFIG_ESP_TASK_WDT_EN=n
CONFIG_ESP_TASK_WDT_INIT=n

# Main task stack size
CONFIG_ESP_MAIN_TASK_STACK_SIZE=10000

# Reduce log noise
CONFIG_LOG_DEFAULT_LEVEL_WARN=y

# Enable PSRAM
CONFIG_SPIRAM=y
CONFIG_SPIRAM_USE_CAPS_ALLOC=y

# Console UART baud rate
CONFIG_ESP_CONSOLE_UART_BAUDRATE=115200

# Compiler optimizations
CONFIG_COMPILER_OPTIMIZATION_PERF=y
```

## examples/test_lpc_asm/sdkconfig.defaults.esp32
```kconfig
# ESP32 specific settings
CONFIG_ESPTOOLPY_FLASHSIZE_4MB=y

# PSRAM mode
CONFIG_SPIRAM_MODE_QUAD=y
CONFIG_SPIRAM_SPEED_80M=y
```

## examples/test_lpc_asm/sdkconfig.defaults.esp32s3
```kconfig
# ESP32-S3 specific settings
CONFIG_ESPTOOLPY_FLASHSIZE_16MB=y

# Octal PSRAM mode
CONFIG_SPIRAM_MODE_OCT=y
CONFIG_SPIRAM_SPEED_80M=y

# Cache optimizations - significant performance improvement
CONFIG_ESP32S3_DATA_CACHE_64KB=y
CONFIG_ESP32S3_DATA_CACHE_LINE_64B=y
CONFIG_ESP32S3_INSTRUCTION_CACHE_32KB=y
```
